#include "MIDIUSB.h" // Bibliothèque pour la communication MIDI via USB
#include <SoftwareSerial.h> // Bibliothèque pour la communication série logicielle
#include "ST7789_AVR.h" 
//#include <SPI.h>

#define TFT_DC   5
#define TFT_CS   4 
#define TFT_RST  6 

// Broches pour la communication série logicielle
#define RX_PIN 9
#define TX_PIN 10
SoftwareSerial mySerial(RX_PIN, TX_PIN);

#define SCR_WD 240
#define SCR_HT 320
ST7789_AVR lcd = ST7789_AVR(TFT_DC, TFT_RST, TFT_CS);
                                                                                                                      
// Configuration des boutons et contrôleurs MIDI
const int pinNumbers[] = {2, 3, 4, 5, 6, 7, 8, 9, 10, 11, 12};
const int controlChanges[] = {50, 51, 52, 53, 54, 48, 49, 75, 78, 77, 76};
int lastSentState[11];

// Buffer pour stocker le message SysEx
#define SYSEX_BUFFER_SIZE 128
byte sysexBuffer[SYSEX_BUFFER_SIZE];
uint8_t sysexIndex = 0;

// Variables pour stocker les noms du rig et de la banque
String rigName = "";
String bankName = "";
String rigBankNumbr ="";
String lastRigBankNumbr ="";
String lastRigName = "";
String lastBankName = "";

// Temporisation entre les requêtes SysEx
#define SYSEX_DELAY 100 // Délai en millisecondes

// Timer pour la récupération automatique
unsigned long lastSysExRequestTime = 0;
#define AUTO_REQUEST_INTERVAL 500 // Intervalle de 1 seconde

const unsigned char kemperLogo [] PROGMEM = {
0x00, 0x00, 0x00, 0x00, 0x00, 0x00, 0x00, 0x00, 0x00, 0x00, 0x00, 0x00, 0x00, 0x00, 0x00, 0x00, 
	0x00, 0x00, 0x00, 0x00, 0x00, 0x00, 0x00, 0x00, 0x00, 0x00, 0x00, 0x00, 0x00, 0x00, 0x00, 0x00, 
	0x00, 0x00, 0x00, 0x00, 0x00, 0x00, 0x00, 0x00, 0x00, 0x00, 0x00, 0x00, 0x00, 0x00, 0x00, 0x00, 
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	0x00, 0x00, 0x00, 0x00, 0x00, 0x00, 0x00, 0x00, 0x00, 0x00, 0x00, 0x00, 0x00, 0x00, 0x00, 0x00
};

void displayKemperLogo() {
  lcd.cls(); // Effacer l'écran
  lcd.drawBitmap(0, 0, kemperLogo, 320, 240, WHITE); // Afficher le logo
}

void setup() {

    mySerial.begin(9600);

    for (int i = 0; i < 11; i++) {
        pinMode(pinNumbers[i], INPUT_PULLUP);
        lastSentState[i] = (i < 7) ? 1 : 0;
    }

  lcd.init(SCR_WD, SCR_HT);
  lcd.setRotation(3);
  lcd.fillScreen(BLACK);
  lcd.setCursor(0, 0);
  displayKemperLogo();
  delay(4000);

}

void loop() {

    // Gestion des boutons et envoi des Control Change
    if (mySerial.available()) {
        String data = mySerial.readStringUntil('\n');
        int delimiterIndex = data.indexOf(';');

        if (delimiterIndex != -1) {
            int pinNumber = data.substring(0, delimiterIndex).toInt();
            int state = data.substring(delimiterIndex + 1).toInt();

            for (int i = 0; i < 11; i++) {
                if (pinNumbers[i] == pinNumber) {
                    state = !state;

                    if (i < 7) {
                        if (state == 1) {
                            sendMIDIControlChange(controlChanges[i], 127);
                            lastSentState[i] = 1;
                        } else if (lastSentState[i] == 1) {
                            sendMIDIControlChange(controlChanges[i], 0);
                            lastSentState[i] = 0;

                            // Temporisation avant de demander les noms
                            delay(SYSEX_DELAY);

                            requestRigBankNumbr();
                            delay(SYSEX_DELAY);

                            requestRigName(); // Demander le nom du rig
                            delay(SYSEX_DELAY); // Temporisation supplémentaire

                            requestBankName();  // Demander le nom de la banque
                        }
                    } else {
                        if (lastSentState[i] != state) {
                            sendMIDIControlChange(controlChanges[i], state ? 127 : 0);
                            lastSentState[i] = state;
                        }
                    }
                }
            }
        }
    }

    // Récupération automatique des noms toutes les secondes
    unsigned long currentTime = millis();
    if (currentTime - lastSysExRequestTime >= AUTO_REQUEST_INTERVAL) {
        lastSysExRequestTime = currentTime; // Mettre à jour le timer

        
        requestRigBankNumbr();
        delay(SYSEX_DELAY);
        // Demander les noms du rig et de la banque
        requestRigName();
        delay(SYSEX_DELAY); // Temporisation entre les requêtes
        requestBankName();
    }

    // Lecture des messages MIDI
    midiEventPacket_t rx;
    do {
        rx = MidiUSB.read();
        if (rx.header != 0) {
            processSysExPacket(rx);
        }
    } while (rx.header != 0);

    delay(50); // Temporisation dans la boucle principale
}

void sendMIDIControlChange(byte control, byte value) {
    midiEventPacket_t event = {0x0B, 0xB0, control, value};
    MidiUSB.sendMIDI(event);
    MidiUSB.flush();
}

void sendSysEx(const byte* sysExMessage, uint8_t sysExLength) {
    for (uint8_t i = 0; i < sysExLength; i += 3) {
        midiEventPacket_t event = {0x04, sysExMessage[i], sysExMessage[i + 1], sysExMessage[i + 2]};
        MidiUSB.sendMIDI(event);
    }
    midiEventPacket_t endEvent = {0x05, 0xF7, 0, 0};
    MidiUSB.sendMIDI(endEvent);
    MidiUSB.flush();
    delay(50); // Temporisation après l'envoi d'un message SysEx
}

void requestRigName() {
    byte rigSysExMessage[] = {0xF0, 0x00, 0x20, 0x33, 0x02, 0x7F, 0x43, 0x00, 0x00, 0x01, 0xF7};
    sendSysEx(rigSysExMessage, sizeof(rigSysExMessage));
}

void requestBankName() {
    byte bankSysExMessage[] = {0xF0, 0x00, 0x20, 0x33, 0x02, 0x7F, 0x43, 0x00, 0x00, 0x04, 0xF7};
    sendSysEx(bankSysExMessage, sizeof(bankSysExMessage));
}

void requestRigBankNumbr() {
    byte rigBankSysExMessage[] = {0xF0, 0x00, 0x20, 0x33, 0x02, 0x7F, 0x43, 0x00, 0x00, 0x02, 0xF7};
    sendSysEx(rigBankSysExMessage, sizeof(rigBankSysExMessage));
}

// Traitement correct des SysEx
void processSysExPacket(midiEventPacket_t rx) {
    if (rx.byte1 == 0xFE) return;  // Ignorer Active Sensing

    // Détecter le début d'un message SysEx
    if (rx.byte1 == 0xF0) {
        memset(sysexBuffer, 0, SYSEX_BUFFER_SIZE);
        sysexIndex = 0;
    }

    // Ajouter les octets sans dépassement
    if (sysexIndex < SYSEX_BUFFER_SIZE - 1) sysexBuffer[sysexIndex++] = rx.byte1;
    if (sysexIndex < SYSEX_BUFFER_SIZE - 1) sysexBuffer[sysexIndex++] = rx.byte2;
    if (sysexIndex < SYSEX_BUFFER_SIZE - 1) sysexBuffer[sysexIndex++] = rx.byte3;

    // Vérifier la fin du message SysEx
    if (rx.byte1 == 0xF7 || rx.byte2 == 0xF7 || rx.byte3 == 0xF7) {
        extractASCII();  // Extraire et afficher l’ASCII
        sysexIndex = 0;
    }
}

void updateDisplay() {
    lcd.fillScreen(BLACK);

    lcd.setTextSize(3);

    // Position
    lcd.setTextColor(WHITE);
    lcd.setCursor(10, 10);
    lcd.print("B/R : ");
    lcd.print(rigBankNumbr);

    // Bank Label
    lcd.setTextColor(WHITE);
    lcd.setCursor(10, 60);
    lcd.print("Bank :");

    // Bank Name (centré)
    lcd.setTextColor(GREEN);
    int bankX = (SCR_HT - (bankName.length() * 12)) / 2;
    lcd.setCursor(bankX, 90);
    lcd.print(bankName);

    // Rig Label
    lcd.setTextColor(WHITE);
    lcd.setCursor(10, 140);
    lcd.print("Rig :");

    // Rig Name (centré)
    lcd.setTextColor(YELLOW);
    int rigX = (SCR_HT - (rigName.length() * 12)) / 2;
    lcd.setCursor(rigX, 170);
    lcd.print(rigName);
}

void extractASCII() {
    const byte rigHeader[] = {0xF0, 0x00, 0x20, 0x33, 0x00, 0x00, 0x03, 0x00, 0x00, 0x01};
    const byte bankHeader[] = {0xF0, 0x00, 0x20, 0x33, 0x00, 0x00, 0x03, 0x00, 0x00, 0x04};
    const byte rigBankNumbrHeader[] = {0xF0, 0x00, 0x20, 0x33, 0x00, 0x00, 0x03, 0x00, 0x00, 0x02};

    const byte footer[] = {0x00, 0xF7};
    int headerLen = sizeof(rigHeader);
    int footerLen = sizeof(footer);

    bool isRig = memcmp(sysexBuffer, rigHeader, headerLen) == 0;
    bool isBank = memcmp(sysexBuffer, bankHeader, headerLen) == 0;
    bool isRigBankNumbr = memcmp(sysexBuffer, rigBankNumbrHeader, headerLen) == 0;

    if (!isRig && !isBank && !isRigBankNumbr) return;

    int footerPos = -1;
    for (int i = sysexIndex - footerLen; i >= headerLen; i--) {
        if (memcmp(&sysexBuffer[i], footer, footerLen) == 0) {
            footerPos = i;
            break;
        }
    }
    if (footerPos == -1) return;

    String name = "";
    for (int i = headerLen; i < footerPos; i++) {
        if (sysexBuffer[i] >= 32 && sysexBuffer[i] <= 126) {
            name += (char)sysexBuffer[i];
        }
    }

    if (isRig && name != rigName) {
        rigName = name;
    } else if (isBank && name != bankName) {
        bankName = name;
    } 
      else if (isRigBankNumbr && name != rigBankNumbr) {
        rigBankNumbr = name;
    }
    else {
        return; // Aucune mise à jour nécessaire
    }

    // Mise à jour de l'affichage seulement si un changement a eu lieu
    if (rigName != lastRigName || bankName != lastBankName || rigBankNumbr != lastRigBankNumbr) {
    lastRigName = rigName;
    lastBankName = bankName;
    lastRigBankNumbr = rigBankNumbr;

    updateDisplay();  // Mise à jour de l'affichage
}
}
